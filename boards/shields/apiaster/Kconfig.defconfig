## boards/shields/apiaster/Kconfig.defconfig
```kconfig
if SHIELD_APIASTER_WIRED

config ZMK_KEYBOARD_NAME
    default "Apiaster"

endif

if SHIELD_APIASTER_LEFT || SHIELD_APIASTER_DONGLE

config ZMK_KEYBOARD_NAME
    default "Apiaster"

config ZMK_SPLIT_ROLE_CENTRAL
    default y

endif

if SHIELD_APIASTER_LEFT || SHIELD_APIASTER_RIGHT || SHIELD_APIASTER_DONGLE

config ZMK_SPLIT
    default y

endif

if SHIELD_APIASTER_DONGLE

config ZMK_SPLIT_BLE_CENTRAL_PERIPHERALS
    default 2

config BT_MAX_CONN
    default 7

config BT_MAX_PAIRED
    default 7

endif
```

## boards/shields/apiaster/Kconfig.shield
```kconfig
config SHIELD_APIASTER_WIRED
    def_bool $(shields_list_contains,apiaster_wired)

config SHIELD_APIASTER_LEFT
    def_bool $(shields_list_contains,apiaster_left)

config SHIELD_APIASTER_RIGHT
    def_bool $(shields_list_contains,apiaster_right)

config SHIELD_APIASTER_DONGLE
    def_bool $(shields_list_contains,apiaster_dongle)
```

## config/west.yml
```yaml
manifest:
  remotes:
    - name: zmkfirmware
      url-base: https://github.com/zmkfirmware
    - name: munnich
      url-base: https://github.com/nmunnich
  projects:
    - name: zmk
      remote: zmkfirmware
      revision: main
      import: app/west.yml
    - name: zmk-component-rp2040-zero
      remote: munnich
      revision: main
  self:
    path: config
```
